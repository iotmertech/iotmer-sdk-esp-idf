## components/ble_manager/Kconfig
```kconfig
menu "BLE Manager Defaults"

    config CUSTOM_BLE_MANAGER_BT_DEFAULTS
        bool "Enable Bluetooth defaults for ble_manager"
        default y
        help
            Enables the default settings for the BLE manager component. 
            When enabled, the project defaults to ‘Bluetooth + NimBLE’ in the initial configuration.

if CUSTOM_BLE_MANAGER_BT_DEFAULTS

    config BT_ENABLED
        default y

    choice BT_HOST
        default BT_NIMBLE_ENABLED
    endchoice

    choice BT_CONTROLLER
        default BT_CONTROLLER_ENABLED
    endchoice

    choice BT_NIMBLE_MEM_ALLOC_MODE
        default BT_NIMBLE_MEM_ALLOC_MODE_INTERNAL
    endchoice

    config BT_NIMBLE_HOST_TASK_STACK_SIZE
        default 4096

    config BT_NIMBLE_ROLE_CENTRAL
        default y

    config BT_NIMBLE_ROLE_PERIPHERAL
        default y

    config BT_NIMBLE_ROLE_BROADCASTER
        default y

    config BT_NIMBLE_ROLE_OBSERVER
        default y

    config BT_NIMBLE_GATT_CLIENT
        default y

    config BT_NIMBLE_GATT_SERVER
        default y

endif

endmenu
```

## components/iotmer/examples/04_config/sdkconfig.defaults
```kconfig
CONFIG_LOG_DEFAULT_LEVEL_INFO=y

CONFIG_COMPILER_OPTIMIZATION_SIZE=y

CONFIG_ESPTOOLPY_FLASHSIZE_4MB=y
CONFIG_PARTITION_TABLE_TWO_OTA=y

CONFIG_MBEDTLS_CERTIFICATE_BUNDLE=y
CONFIG_MBEDTLS_CERTIFICATE_BUNDLE_DEFAULT_FULL=y
CONFIG_MBEDTLS_CERTIFICATE_BUNDLE_CROSS_SIGNED_VERIFY=y

CONFIG_ESP_MAIN_TASK_STACK_SIZE=8192

CONFIG_ESP_TASK_WDT_TIMEOUT_S=30

CONFIG_IOTMER_WIFI_SSID=""
CONFIG_IOTMER_WIFI_PASSWORD=""

CONFIG_IOTMER_PROVISION_AUTH_CODE=""
CONFIG_IOTMER_WORKSPACE_ID=""
CONFIG_IOTMER_WORKSPACE_SLUG=""
CONFIG_IOTMER_TEMPLATE_ID=""
```

## components/iotmer/examples/05_ble_wifi_prov/sdkconfig.defaults
```kconfig
CONFIG_LOG_DEFAULT_LEVEL_INFO=y
CONFIG_COMPILER_OPTIMIZATION_SIZE=y
CONFIG_ESPTOOLPY_FLASHSIZE_4MB=y
# Default 1 MB app slot is too small for BT + iotmer + cJSON (link ~1.12 MB).
CONFIG_PARTITION_TABLE_SINGLE_APP_LARGE=y

CONFIG_ESP_MAIN_TASK_STACK_SIZE=8192
CONFIG_ESP_TASK_WDT_TIMEOUT_S=30

CONFIG_BT_ENABLED=y
CONFIG_BT_NIMBLE_ENABLED=y
CONFIG_BT_NIMBLE_MAX_CONNECTIONS=1
CONFIG_BT_NIMBLE_ROLE_PERIPHERAL=y
CONFIG_BT_NIMBLE_ROLE_BROADCASTER=y

CONFIG_IOTMER_BLE_WIFI_PROV=y

# HTTPS (iotmer_provision, bind-claim) + MQTT TLS — same as examples/01_provisioning.
# Without FULL + CROSS_SIGNED, esp_crt_bundle may fail handshake to console.iotmer.com
# ("No matching trusted root certificate found") when bind-claim runs after provision skip.
CONFIG_MBEDTLS_CERTIFICATE_BUNDLE=y
CONFIG_MBEDTLS_CERTIFICATE_BUNDLE_DEFAULT_FULL=y
CONFIG_MBEDTLS_CERTIFICATE_BUNDLE_CROSS_SIGNED_VERIFY=y

CONFIG_IOTMER_WIFI_SSID=""
CONFIG_IOTMER_WIFI_PASSWORD=""

CONFIG_IOTMER_PROVISION_AUTH_CODE=""
CONFIG_IOTMER_WORKSPACE_ID=""
CONFIG_IOTMER_WORKSPACE_SLUG=""
CONFIG_IOTMER_TEMPLATE_ID=""
```

## components/iotmer_ble/Kconfig.projbuild
```kconfig
if SOC_BT_SUPPORTED

menu "IOTMER BLE (JSON channel)"

config IOTMER_BLE
    bool "Enable IOTMER BLE JSON channel (NimBLE GATT server)"
    default n
    help
        Adds a small GATT service intended for application-layer JSON messages over BLE.
        This is a general transport; Wi-Fi provisioning can be implemented on top at the app layer.

config IOTMER_BLE_GAP_NAME_PREFIX
    string "GAP device name prefix"
    default "IOTMER-"
    depends on IOTMER_BLE
    help
        Advertised name prefix. The implementation appends a short MAC-derived hex suffix.

config IOTMER_BLE_MAX_RX_LEN
    int "Maximum received JSON bytes per ATT write"
    default 512
    range 32 2048
    depends on IOTMER_BLE
    help
        Upper bound for a single received JSON frame. Centrals should request a larger MTU.

config IOTMER_BLE_RESTART_ADV_ON_DISCONNECT
    bool "Resume advertising after disconnect"
    default y
    depends on IOTMER_BLE

config IOTMER_BLE_SMP_IO_CAP
    int "BLE SMP IO capability (NimBLE ble_hs_cfg.sm_io_cap)"
    default 3
    range 0 4
    depends on IOTMER_BLE
    help
        0=DISPLAY_ONLY, 1=DISPLAY_YESNO, 2=KEYBOARD_ONLY, 3=NO_IO (Just Works), 4=KEYBOARD_DISP.

config IOTMER_BLE_REQUIRE_ENC
    bool "Require link encryption for writes"
    default y
    depends on IOTMER_BLE
    help
        When enabled, the RX characteristic requires encrypted writes. This improves security but
        requires the central to pair/bond (or otherwise enable encryption) before sending JSON.

endmenu

endif # SOC_BT_SUPPORTED
```

## components/iotmer_ble_wifi_prov/Kconfig.projbuild
```kconfig
# Kconfig for `iotmer_ble_wifi_prov` — must live in this component so symbols exist in sdkconfig
# whenever the component is part of the build (CMake uses CONFIG_IOTMER_BLE_WIFI_PROV).

if SOC_BT_SUPPORTED

menu "IOTMER BLE Wi-Fi provisioning (GATT v1)"

config IOTMER_BLE_WIFI_PROV
    bool "Compile IOTMER BLE Wi-Fi provisioning module (NimBLE)"
    default n
    help
        When enabled, this component links the IOTMER-defined GATT protocol (v1) for Wi-Fi credential transfer.
        Applications must still enable NimBLE in sdkconfig and add `REQUIRES iotmer_ble_wifi_prov`.

config IOTMER_BLE_ADV_TIMEOUT_MS
    int "BLE provisioning: advertising timeout (ms, 0 = until stop())"
    default 300000
    depends on IOTMER_BLE_WIFI_PROV
    help
        After `iotmer_ble_wifi_prov_start()`, advertising stops automatically when this elapses
        with no active GATT connection. Set 0 to advertise until `stop()` or connection handling.

config IOTMER_BLE_CONN_IDLE_MS
    int "BLE provisioning: connected idle timeout (ms)"
    default 120000
    depends on IOTMER_BLE_WIFI_PROV
    help
        If no valid Control/Data write resets the idle timer for this long, the session aborts.

config IOTMER_BLE_SESSION_MAX_MS
    int "BLE provisioning: maximum session duration after connect (ms)"
    default 600000
    depends on IOTMER_BLE_WIFI_PROV
    help
        Hard cap from first GATT activity after connection; forces teardown even if idle timer keeps resetting.

config IOTMER_BLE_ADV_NAME_PREFIX
    string "BLE provisioning: GAP device name prefix"
    default "IOTMER-"
    depends on IOTMER_BLE_WIFI_PROV
    help
        Full advertised name is prefix + short hex suffix (MAC-derived). Do not put secrets in the name.

config IOTMER_BLE_RESTART_ADV_ON_DISCONNECT
    bool "BLE provisioning: resume advertising after disconnect (until stop/timeout)"
    default y
    depends on IOTMER_BLE_WIFI_PROV
    help
        When y, a dropped link during an active `start()` window resumes connectable advertising
        until advertising timeout or `iotmer_ble_wifi_prov_stop()`.

config IOTMER_BLE_SMP_IO_CAP
    int "BLE SMP IO capability (NimBLE ble_hs_cfg.sm_io_cap)"
    default 3
    depends on IOTMER_BLE_WIFI_PROV
    range 0 4
    help
        0=DISPLAY_ONLY, 1=DISPLAY_YESNO, 2=KEYBOARD_ONLY, 3=NO_IO (Just Works default), 4=KEYBOARD_DISP.
        Passkey flows require app/firmware UI; defaults stay NO_IO.

endmenu

endif # SOC_BT_SUPPORTED
```

## examples/02_telemetry/sdkconfig.defaults
```kconfig
CONFIG_LOG_DEFAULT_LEVEL_INFO=y

# Debug (-Og) exceeds 1 MiB app slots with TWO_OTA + mbedTLS bundle; -Os fits comfortably.
CONFIG_COMPILER_OPTIMIZATION_SIZE=y

CONFIG_ESPTOOLPY_FLASHSIZE_4MB=y
CONFIG_PARTITION_TABLE_TWO_OTA=y

# HTTPS provisioning + MQTT TLS need the Mozilla CA bundle (esp_crt_bundle_attach).
CONFIG_MBEDTLS_CERTIFICATE_BUNDLE=y
CONFIG_MBEDTLS_CERTIFICATE_BUNDLE_DEFAULT_FULL=y
CONFIG_MBEDTLS_CERTIFICATE_BUNDLE_CROSS_SIGNED_VERIFY=y

# Provisioning + MQTT on app_main need extra stack for mbedTLS.
CONFIG_ESP_MAIN_TASK_STACK_SIZE=8192

CONFIG_ESP_TASK_WDT_TIMEOUT_S=30

CONFIG_IOTMER_WIFI_SSID=""
CONFIG_IOTMER_WIFI_PASSWORD=""

CONFIG_IOTMER_PROVISION_AUTH_CODE=""
CONFIG_IOTMER_WORKSPACE_ID=""
CONFIG_IOTMER_WORKSPACE_SLUG=""
CONFIG_IOTMER_TEMPLATE_ID=""
```

## examples/05_ble_wifi_prov/main/Kconfig.projbuild
```kconfig
menu "IOTMER example 05 (BLE Wi‑Fi + claim demo)"

    config IOTMER_05_DEMO_CLAIM_CODE
        string "Optional: demo claim code (lab, bind without GATT claim.set)"
        default ""
        help
            If set (e.g. pc_... from your backend), firmware uses it for bind-claim when no
            claim_code was received on the Claim GATT. Leave empty in production: use
            the …0404… characteristic or pc_ble_client --claim.

endmenu
```

## examples/05_ble_wifi_prov/sdkconfig.defaults
```kconfig
CONFIG_LOG_DEFAULT_LEVEL_INFO=y
CONFIG_COMPILER_OPTIMIZATION_SIZE=y
CONFIG_ESPTOOLPY_FLASHSIZE_4MB=y

CONFIG_ESP_MAIN_TASK_STACK_SIZE=8192
CONFIG_ESP_TASK_WDT_TIMEOUT_S=30

CONFIG_BT_ENABLED=y
CONFIG_BT_NIMBLE_ENABLED=y
CONFIG_BT_NIMBLE_MAX_CONNECTIONS=1
CONFIG_BT_NIMBLE_ROLE_PERIPHERAL=y
CONFIG_BT_NIMBLE_ROLE_BROADCASTER=y

CONFIG_IOTMER_BLE_WIFI_PROV=y

CONFIG_IOTMER_WIFI_SSID=""
CONFIG_IOTMER_WIFI_PASSWORD=""

CONFIG_IOTMER_PROVISION_AUTH_CODE=""
CONFIG_IOTMER_WORKSPACE_ID=""
CONFIG_IOTMER_WORKSPACE_SLUG=""
CONFIG_IOTMER_TEMPLATE_ID=""
```
